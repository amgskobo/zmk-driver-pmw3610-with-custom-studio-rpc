## CMakeLists.txt
```
cmake_minimum_required(VERSION 3.20.0)
if(NOT PMW3610_NANOPB_DIR)
  message(FATAL_ERROR "Pass the selected West nanopb project as PMW3610_NANOPB_DIR")
endif()
# This isolated app uses actual Zephyr/nanopb with synthetic sensor/Studio/split
# boundaries. Do not include the production ZMK app or duplicate owner modules.
set(ZEPHYR_MODULES ${PMW3610_NANOPB_DIR})
find_package(Zephyr REQUIRED HINTS $ENV{ZEPHYR_BASE})
project(pmw3610_regressions)
get_filename_component(OWNER_ROOT ../.. ABSOLUTE)
target_include_directories(app BEFORE PRIVATE stubs ${OWNER_ROOT}/include ${CMAKE_CURRENT_BINARY_DIR} ${CMAKE_CURRENT_BINARY_DIR}/proto)
target_sources(app PRIVATE src/fixtures.c src/executor.c src/relay.c)
target_compile_definitions(app PRIVATE
  CONFIG_ZMK_SPLIT=1 CONFIG_ZMK_PMW3610_SPLIT_RPC_RELAY=1
  CONFIG_ZMK_PMW3610_STUDIO_RPC_FRAME_BUF_SIZE=484 CONFIG_ZMK_STUDIO_RPC_TX_BUF_SIZE=256
  CONFIG_ZMK_PMW3610_FRAME_STREAM_LEASE_MS=1000
  CONFIG_ZMK_SPLIT_RELAY_EVENT_DATA_LEN=240 CONFIG_ZMK_PMW3610_RELAY_QUEUE_DEPTH=8 CONFIG_ZMK_LOG_LEVEL=0)
if(PMW3610_CENTRAL)
  target_compile_definitions(app PRIVATE CONFIG_ZMK_SPLIT_ROLE_CENTRAL=1)
endif()
list(APPEND CMAKE_MODULE_PATH ${ZEPHYR_BASE}/modules/nanopb)
include(nanopb)
set(NANOPB_GENERATE_CPP_APPEND_PATH TRUE)
set(NANOPB_GENERATE_CPP_STANDALONE OFF)
nanopb_generate_cpp(proto_srcs proto_hdrs RELPATH ${OWNER_ROOT}
  ${OWNER_ROOT}/proto/cormoran/pmw3610/pmw3610.proto)
target_sources(app PRIVATE ${proto_srcs} ${proto_hdrs})
```

## prj.conf
```kconfig
CONFIG_ZTEST=y
CONFIG_ASSERT=y
CONFIG_MAIN_STACK_SIZE=8192
CONFIG_TEST_EXTRA_STACK_SIZE=8192
CONFIG_NANOPB=y
CONFIG_NANOPB_WITHOUT_64BIT=y
```

## src/executor.c
```c
#include "fixtures.h"
/* Include the full production implementation to exercise its private session
 * transitions without exposing test hooks in production builds. */
#include "../../../src/studio/pmw3610_request_exec.c"

static void before(void *fixture) {
    ARG_UNUSED(fixture);
    test_start_queue();
    test_lock_state = ZMK_STUDIO_CORE_LOCK_STATE_UNLOCKED;
    pmw3610_request_stop_stream();
    k_timer_stop(&frame_stream_lease_timer);
    test_release_queue();
    k_work_flush_delayable(&frame_stream_work, &(struct k_work_sync){0});
    test_drain_queue();
    zassert_false(test_sensor_capturing[0]);
    zassert_false(test_sensor_capturing[1]);
    test_clear_sinks();
}

static cormoran_pmw3610_Response start(uint32_t index) {
    cormoran_pmw3610_Request request = cormoran_pmw3610_Request_init_zero;
    request.which_request_type = cormoran_pmw3610_Request_set_frame_stream_tag;
    request.request_type.set_frame_stream.enable = true;
    request.request_type.set_frame_stream.device_index = index;
    request.request_type.set_frame_stream.pixel_count = 484;
    cormoran_pmw3610_Response response = cormoran_pmw3610_Response_init_zero;
    zassert_true(pmw3610_request_exec_handle(&request, &response));
    return response;
}

static cormoran_pmw3610_Response renew(uint32_t epoch) {
    cormoran_pmw3610_Request request = cormoran_pmw3610_Request_init_zero;
    request.which_request_type = cormoran_pmw3610_Request_set_frame_stream_tag;
    request.request_type.set_frame_stream.enable = true;
    request.request_type.set_frame_stream.renew_only = true;
    request.request_type.set_frame_stream.stream_epoch = epoch;
    request.request_type.set_frame_stream.pixel_count = 484;
    cormoran_pmw3610_Response response = cormoran_pmw3610_Response_init_zero;
    zassert_true(pmw3610_request_exec_handle(&request, &response));
    return response;
}

void test_lock(void) {
    test_lock_state = ZMK_STUDIO_CORE_LOCK_STATE_LOCKED;
#if !PMW3610_IS_SPLIT_PERIPHERAL
    struct zmk_studio_core_lock_state_changed event = {.state = test_lock_state};
    on_studio_core_lock_state_changed(&event);
#endif
}

void test_disconnect(void) {
#if PMW3610_IS_SPLIT_PERIPHERAL
    struct zmk_split_peripheral_status_changed event = {.connected = false};
    on_split_peripheral_status_changed(&event);
#endif
}

ZTEST(sessions, test_retarget_rejected_and_original_sensor_released) {
    test_block_queue();
    cormoran_pmw3610_Response response = start(0);
    zassert_equal(response.which_response_type, cormoran_pmw3610_Response_set_frame_stream_tag);
    response = start(1);
    zassert_equal(response.which_response_type, cormoran_pmw3610_Response_error_tag);
    zassert_true(test_sensor_capturing[0]);
    zassert_false(test_sensor_capturing[1]);
    response = start(0);
    zassert_equal(response.which_response_type, cormoran_pmw3610_Response_set_frame_stream_tag);
    pmw3610_request_stop_stream();
    /* A restart cannot steal ownership before the previous worker cleans up. */
    response = start(1);
    zassert_equal(response.which_response_type, cormoran_pmw3610_Response_error_tag);
    test_release_queue();
    test_drain_queue();
    zassert_equal(test_begin_calls[0], 1);
    zassert_equal(test_end_calls[0], 1);
    zassert_equal(test_end_calls[1], 0);
    test_block_queue();
    response = start(1);
    zassert_equal(response.which_response_type, cormoran_pmw3610_Response_set_frame_stream_tag);
    pmw3610_request_stop_stream();
    test_release_queue();
    test_drain_queue();
    zassert_equal(test_begin_calls[1], 1);
    zassert_equal(test_end_calls[1], 1);
}

ZTEST(sessions, test_cancel_during_begin_releases_sensor) {
    test_cancel_begin = true;
    cormoran_pmw3610_Response response = start(0);
    test_drain_queue();
    zassert_equal(response.which_response_type, cormoran_pmw3610_Response_error_tag);
    zassert_equal(test_begin_calls[0], 1);
    zassert_equal(test_end_calls[0], 1);
    zassert_false(test_sensor_capturing[0]);
    zassert_equal(test_notification_count, 0);
}

ZTEST(sessions, test_cancel_during_read_sends_no_chunks) {
    test_block_queue();
    test_cancel_read = true;
    cormoran_pmw3610_Response response = start(0);
    zassert_equal(response.which_response_type, cormoran_pmw3610_Response_set_frame_stream_tag);
    test_release_queue();
    test_drain_queue();
    zassert_equal(test_end_calls[0], 1);
    zassert_equal(test_notification_count, 0);
}

ZTEST(sessions, test_one_shot_rejected_until_stream_cleanup) {
    test_block_queue();
    start(0);
    pmw3610_request_stop_stream();
    cormoran_pmw3610_Request request = cormoran_pmw3610_Request_init_zero;
    cormoran_pmw3610_Response response = cormoran_pmw3610_Response_init_zero;
    request.which_request_type = cormoran_pmw3610_Request_capture_frame_tag;
    zassert_true(pmw3610_request_exec_handle(&request, &response));
    zassert_equal(response.which_response_type, cormoran_pmw3610_Response_error_tag);
    test_release_queue();
    test_drain_queue();
    zassert_true(pmw3610_request_exec_handle(&request, &response));
    zassert_equal(response.which_response_type, cormoran_pmw3610_Response_capture_frame_tag);
    zassert_equal(test_begin_calls[0], 2);
    zassert_equal(test_end_calls[0], 2);
}

ZTEST(sessions, test_lock_or_disconnect_retires_pending_stream) {
    test_block_queue();
    start(0);
#if PMW3610_IS_SPLIT_PERIPHERAL
    struct zmk_split_peripheral_status_changed event = {.connected = false};
    on_split_peripheral_status_changed(&event);
#else
    test_lock();
    zassert_equal(test_stop_count, 1);
#endif
    test_release_queue();
    test_drain_queue();
    zassert_equal(test_notification_count, 0);
    zassert_equal(test_end_calls[0], 1);
    zassert_equal(frame_stream_lease_deadline, 0);
}

ZTEST(sessions, test_client_lease_expires_without_queue_progress_or_renewal) {
    test_block_queue();
    uint32_t epoch = start(0).response_type.set_frame_stream.stream_epoch;
    zassert_not_equal(epoch, 0);
    k_sleep(K_MSEC(CONFIG_ZMK_PMW3610_FRAME_STREAM_LEASE_MS + 20));
    zassert_false(atomic_get(&frame_stream_active));
    zassert_true(test_sensor_capturing[0]); /* cleanup still waits for the queue */
    cormoran_pmw3610_Response response = start(0);
    zassert_equal(response.which_response_type, cormoran_pmw3610_Response_error_tag);
    test_release_queue();
    test_drain_queue();
    zassert_false(test_sensor_capturing[0]);
    zassert_equal(test_end_calls[0], 1);
    zassert_equal(test_notification_count, 0);
    /* Cleanup has completed: an old renewal must still never start a session. */
    response = renew(epoch);
    zassert_equal(response.which_response_type, cormoran_pmw3610_Response_error_tag);
    zassert_equal(test_begin_calls[0], 1);
    zassert_false(test_sensor_capturing[0]);
    test_block_queue();
    uint32_t replacement_epoch = start(0).response_type.set_frame_stream.stream_epoch;
    zassert_not_equal(replacement_epoch, 0);
    zassert_not_equal(replacement_epoch, epoch);
    response = renew(epoch);
    zassert_equal(response.which_response_type, cormoran_pmw3610_Response_error_tag);
    response = renew(0);
    zassert_equal(response.which_response_type, cormoran_pmw3610_Response_error_tag);
    response = renew(replacement_epoch);
    zassert_equal(response.which_response_type, cormoran_pmw3610_Response_set_frame_stream_tag);
    pmw3610_request_stop_stream();
    test_release_queue();
    test_drain_queue();
    zassert_equal(test_end_calls[0], 2);
}

K_SEM_DEFINE(frame_mutex_held, 0, 1);
K_SEM_DEFINE(frame_mutex_release, 0, 1);
K_THREAD_STACK_DEFINE(frame_mutex_stack, 2048);
static struct k_thread frame_mutex_thread;
static bool frame_mutex_thread_started;

static void hold_frame_mutex(void *a, void *b, void *c) {
    ARG_UNUSED(a);
    ARG_UNUSED(b);
    ARG_UNUSED(c);
    k_mutex_lock(&frame_lock, K_FOREVER);
    k_sem_give(&frame_mutex_held);
    k_sem_take(&frame_mutex_release, K_FOREVER);
    k_mutex_unlock(&frame_lock);
}

ZTEST(sessions, test_identical_renewal_extends_lease_while_frame_mutex_is_busy) {
    test_block_queue();
    uint32_t epoch = start(0).response_type.set_frame_stream.stream_epoch;
    int64_t original_deadline = frame_stream_lease_deadline;
    k_thread_create(&frame_mutex_thread, frame_mutex_stack,
                    K_THREAD_STACK_SIZEOF(frame_mutex_stack), hold_frame_mutex, NULL, NULL, NULL, 4,
                    0, K_NO_WAIT);
    frame_mutex_thread_started = true;
    zassert_ok(k_sem_take(&frame_mutex_held, K_SECONDS(2)));
    k_sleep(K_MSEC(CONFIG_ZMK_PMW3610_FRAME_STREAM_LEASE_MS / 2));
    cormoran_pmw3610_Response response = renew(epoch);
    zassert_equal(response.which_response_type, cormoran_pmw3610_Response_set_frame_stream_tag);
    zassert_true(frame_stream_lease_deadline > original_deadline);
    zassert_equal(test_begin_calls[0], 1);
    k_sem_give(&frame_mutex_release);
    zassert_ok(k_thread_join(&frame_mutex_thread, K_SECONDS(2)));
    frame_mutex_thread_started = false;
    k_sleep(K_MSEC(CONFIG_ZMK_PMW3610_FRAME_STREAM_LEASE_MS / 2 + 20));
    zassert_true(atomic_get(&frame_stream_active));
    k_sleep(K_MSEC(CONFIG_ZMK_PMW3610_FRAME_STREAM_LEASE_MS / 2 + 20));
    zassert_false(atomic_get(&frame_stream_active));
    test_release_queue();
    test_drain_queue();
    zassert_equal(test_end_calls[0], 1);
}

ZTEST(sessions, test_failed_capture_invalidates_previously_readable_frame) {
    cormoran_pmw3610_Request request = cormoran_pmw3610_Request_init_zero;
    cormoran_pmw3610_Response response = cormoran_pmw3610_Response_init_zero;
    request.which_request_type = cormoran_pmw3610_Request_capture_frame_tag;
    zassert_true(pmw3610_request_exec_handle(&request, &response));
    zassert_equal(response.which_response_type, cormoran_pmw3610_Response_capture_frame_tag);
    uint32_t previous_id = response.response_type.capture_frame.frame_id;
    test_fail_read = true;
    zassert_true(pmw3610_request_exec_handle(&request, &response));
    zassert_equal(response.which_response_type, cormoran_pmw3610_Response_error_tag);
    request.which_request_type = cormoran_pmw3610_Request_get_frame_chunk_tag;
    request.request_type.get_frame_chunk.frame_id = previous_id;
    request.request_type.get_frame_chunk.offset = 0;
    zassert_true(pmw3610_request_exec_handle(&request, &response));
    zassert_equal(response.which_response_type, cormoran_pmw3610_Response_error_tag);
    zassert_equal(frame_len, 0);
}

static void after(void *fixture) {
    ARG_UNUSED(fixture);
    /* Assertions can leave the queue gate or frame-mutex helper parked. Stop
     * production resubmissions and release both before waiting for cleanup. */
    pmw3610_request_stop_stream();
    k_timer_stop(&frame_stream_lease_timer);
    test_release_queue();
    if (frame_mutex_thread_started) {
        k_sem_give(&frame_mutex_release);
        int ret = k_thread_join(&frame_mutex_thread, K_SECONDS(2));
        if (ret != 0) {
            zassert_ok(ret, "Frame-mutex fixture cleanup did not complete");
            return; /* Do not wait indefinitely on its still-owned mutex. */
        }
        frame_mutex_thread_started = false;
    }
    k_sem_reset(&frame_mutex_held);
    k_sem_reset(&frame_mutex_release);
    k_work_flush_delayable(&frame_stream_work, &(struct k_work_sync){0});
    test_drain_queue();
}

ZTEST_SUITE(sessions, NULL, NULL, before, after, NULL);
```

## src/fixtures.c
```c
#include "fixtures.h"
#include <stdio.h>
#include <pb_decode.h>
#include <pb_encode.h>
#include <zephyr/sys/atomic.h>
#include <cormoran/pmw3610/pmw3610_api.h>
#include <zmk/studio/custom.h>
#include <zmk/split/central.h>

static struct k_work_q queue;
K_THREAD_STACK_DEFINE(queue_stack, 8192);
K_SEM_DEFINE(gate_entered, 0, 1);
K_SEM_DEFINE(gate_release, 0, 1);
static atomic_t gate_owned;
bool test_sensor_capturing[2];
unsigned test_begin_calls[2], test_end_calls[2];
bool test_cancel_begin, test_cancel_read, test_fail_read;
void (*test_begin_hook)(void);
unsigned test_notification_count, test_response_count, test_request_count, test_stop_count;
cormoran_pmw3610_Notification test_notifications[64];
cormoran_pmw3610_RelayResponse test_responses[64];
int test_stop_error;
enum zmk_studio_core_lock_state test_lock_state = ZMK_STUDIO_CORE_LOCK_STATE_UNLOCKED;
static struct device devices[2];

struct k_work_q *zmk_workqueue_lowprio_work_q(void) { return &queue; }
void test_start_queue(void) {
    static bool started;
    if (!started) {
        k_work_queue_start(&queue, queue_stack, K_THREAD_STACK_SIZEOF(queue_stack), 5, NULL);
        started = true;
    }
}
static void gate_handler(struct k_work *work) {
    ARG_UNUSED(work);
    k_sem_give(&gate_entered);
    k_sem_take(&gate_release, K_FOREVER);
}
K_WORK_DEFINE(gate, gate_handler);
void test_block_queue(void) {
    zassert_equal(k_work_busy_get(&gate), 0);
    zassert_true(atomic_cas(&gate_owned, 0, 1));
    k_sem_reset(&gate_entered);
    k_sem_reset(&gate_release);
    k_work_submit_to_queue(&queue, &gate);
    zassert_ok(k_sem_take(&gate_entered, K_SECONDS(2)));
}
void test_release_queue(void) {
    /* A failed case and its cleanup may both release the same gate. */
    if (atomic_cas(&gate_owned, 1, 0)) {
        k_sem_give(&gate_release);
    }
}
void test_drain_queue(void) {
    k_work_queue_drain(&queue, false);
    /* The gate handler has returned, so neither reset can steal its permit. */
    k_sem_reset(&gate_entered);
    k_sem_reset(&gate_release);
}
void test_clear_sinks(void) {
    test_notification_count = test_response_count = test_request_count = test_stop_count = 0;
    test_stop_error = 0;
    test_cancel_begin = test_cancel_read = false;
    test_fail_read = false;
    test_begin_hook = NULL;
    memset(test_begin_calls, 0, sizeof(test_begin_calls));
    memset(test_end_calls, 0, sizeof(test_end_calls));
}
enum zmk_studio_core_lock_state zmk_studio_core_get_lock_state(void) { return test_lock_state; }
int zmk_split_central_send_relay_event(struct zmk_split_relay_event_payload *payload) {
    zassert_mem_equal(payload->event_type, "pms", 3);
    zassert_equal(payload->header.event_data_size, 1);
    test_stop_count++;
    return test_stop_error;
}
void test_record_notification(const uint8_t *payload, size_t size) {
    zassert_true(test_notification_count < ARRAY_SIZE(test_notifications));
    pb_istream_t stream = pb_istream_from_buffer(payload, size);
    zassert_true(pb_decode(&stream, cormoran_pmw3610_Notification_fields,
                           &test_notifications[test_notification_count++]));
}
int raise_zmk_studio_custom_notification(struct zmk_studio_custom_notification event) {
    uint8_t payload[cormoran_pmw3610_Notification_size];
    pb_ostream_t stream = pb_ostream_from_buffer(payload, sizeof(payload));
    zassert_true(event.encode_payload.funcs.encode(&stream, NULL, &event.encode_payload.arg));
    test_record_notification(payload, stream.bytes_written);
    return 0;
}
size_t pmw3610_device_count(void) { return 2; }
const struct device *pmw3610_get_device(size_t index) { return index < 2 ? &devices[index] : NULL; }
bool pmw3610_is_ready(const struct device *device) { return device != NULL; }
int pmw3610_get_init_error(const struct device *device) { return device ? 0 : -ENODEV; }
int pmw3610_get_device_id(const struct device *device, char *buffer, size_t length) {
    ARG_UNUSED(device);
    snprintf(buffer, length, "synthetic");
    return 0;
}
int pmw3610_read_register(const struct device *device, uint8_t address, uint8_t *value) {
    ARG_UNUSED(device);
    *value = address;
    return 0;
}
int pmw3610_write_register(const struct device *device, uint8_t address, uint8_t value) {
    ARG_UNUSED(device);
    ARG_UNUSED(address);
    ARG_UNUSED(value);
    return 0;
}
int pmw3610_read_diagnostics(const struct device *device, struct pmw3610_diagnostics *out) {
    ARG_UNUSED(device);
    memset(out, 0, sizeof(*out));
    return 0;
}
int pmw3610_get_runtime_config(const struct device *device, struct pmw3610_runtime_config *out) {
    ARG_UNUSED(device);
    memset(out, 0, sizeof(*out));
    return 0;
}
int pmw3610_frame_capture_begin(const struct device *device,
                                const struct pmw3610_frame_capture_params *params) {
    ARG_UNUSED(params);
    unsigned index = device - devices;
    zassert_false(test_sensor_capturing[index]);
    test_sensor_capturing[index] = true;
    test_begin_calls[index]++;
    if (test_begin_hook)
        test_begin_hook();
    if (test_cancel_begin)
        pmw3610_request_stop_stream();
    return 0;
}
int pmw3610_frame_capture_read(const struct device *device,
                               const struct pmw3610_frame_capture_params *params, uint8_t *buffer,
                               uint16_t length, struct pmw3610_frame_capture_result *result) {
    zassert_true(test_sensor_capturing[device - devices]);
    result->pixel_count = MIN(params->pixel_count ? params->pixel_count : 484, length);
    memset(buffer, 0x81, result->pixel_count);
    if (test_fail_read) {
        buffer[0] = 0x9a;
        pmw3610_request_stop_stream();
        return -EIO;
    }
    result->complete = true;
    if (test_cancel_read)
        pmw3610_request_stop_stream();
    return 0;
}
int pmw3610_frame_capture_end(const struct device *device) {
    unsigned index = device - devices;
    zassert_true(test_sensor_capturing[index]);
    test_sensor_capturing[index] = false;
    test_end_calls[index]++;
    return 0;
}
int pmw3610_capture_frame(const struct device *device,
                          const struct pmw3610_frame_capture_params *params, uint8_t *buffer,
                          uint16_t length, struct pmw3610_frame_capture_result *result) {
    pmw3610_frame_capture_begin(device, params);
    int err = pmw3610_frame_capture_read(device, params, buffer, length, result);
    int end_err = pmw3610_frame_capture_end(device);
    return err ? err : end_err;
}
```

## src/fixtures.h
```c
#pragma once
#include <zephyr/kernel.h>
#include <zephyr/ztest.h>
#include <cormoran/pmw3610/pmw3610.pb.h>
#include <cormoran/pmw3610/pmw3610_request_exec.h>
#include <zmk/studio/core.h>

extern bool test_sensor_capturing[2];
extern unsigned test_begin_calls[2], test_end_calls[2];
extern bool test_cancel_begin, test_cancel_read, test_fail_read;
extern void (*test_begin_hook)(void);
extern unsigned test_notification_count, test_response_count, test_request_count, test_stop_count;
extern cormoran_pmw3610_Notification test_notifications[64];
extern cormoran_pmw3610_RelayResponse test_responses[64];
extern int test_stop_error;
void test_start_queue(void);
void test_block_queue(void);
void test_release_queue(void);
void test_drain_queue(void);
void test_clear_sinks(void);
void test_record_notification(const uint8_t *payload, size_t size);
void test_lock(void);
void test_disconnect(void);
```

## src/relay.c
```c
#include "fixtures.h"
#include "../../../src/split/pmw3610_relay.c"

int raise_zmk_pmw3610_relay_request(struct zmk_pmw3610_relay_request event) {
    ARG_UNUSED(event);
    test_request_count++;
    return 0;
}
int raise_zmk_pmw3610_relay_response(struct zmk_pmw3610_relay_response event) {
    zassert_true(test_response_count < ARRAY_SIZE(test_responses));
    pb_istream_t stream = pb_istream_from_buffer(event.payload, event.size);
    zassert_true(pb_decode(&stream, cormoran_pmw3610_RelayResponse_fields,
                           &test_responses[test_response_count++]));
    return 0;
}
int raise_zmk_pmw3610_relay_notification(struct zmk_pmw3610_relay_notification event) {
    test_record_notification(event.payload, event.size);
    return 0;
}
int raise_zmk_pmw3610_relay_stop(struct zmk_pmw3610_relay_stop event) {
    ARG_UNUSED(event);
    return 0;
}

static void before(void *fixture) {
    ARG_UNUSED(fixture);
    test_start_queue();
    pmw3610_request_stop_stream();
    test_drain_queue();
    test_lock_state = ZMK_STUDIO_CORE_LOCK_STATE_UNLOCKED;
#if IS_ENABLED(CONFIG_ZMK_SPLIT_ROLE_CENTRAL)
    k_work_cancel_delayable_sync(&relay_stop_work, &(struct k_work_sync){0});
    stop_pending = false;
    atomic_clear(&relay_stream_enabled);
    k_msgq_purge(&relay_response_queue);
    k_msgq_purge(&relay_notification_queue);
    next_relay_request_id = first_current_request_id = 1;
#else
    k_msgq_purge(&relay_request_queue);
#endif
    test_clear_sinks();
}

#if IS_ENABLED(CONFIG_ZMK_SPLIT_ROLE_CENTRAL)
static uint32_t request(bool stream) {
    cormoran_pmw3610_Request request = cormoran_pmw3610_Request_init_zero;
    if (stream) {
        request.which_request_type = cormoran_pmw3610_Request_set_frame_stream_tag;
        request.request_type.set_frame_stream.enable = true;
        request.request_type.set_frame_stream.source = 1;
    } else {
        request.which_request_type = cormoran_pmw3610_Request_get_info_tag;
        request.request_type.get_info.source = 1;
    }
    return send_relay_request(&request);
}
static struct zmk_pmw3610_relay_notification chunk(uint32_t offset) {
    cormoran_pmw3610_Notification notification = cormoran_pmw3610_Notification_init_zero;
    notification.which_notification_type = cormoran_pmw3610_Notification_frame_stream_chunk_tag;
    notification.notification_type.frame_stream_chunk.frame_id = 9;
    notification.notification_type.frame_stream_chunk.offset = offset;
    notification.notification_type.frame_stream_chunk.total_size = 484;
    notification.notification_type.frame_stream_chunk.data.size = 1;
    notification.notification_type.frame_stream_chunk.data.bytes[0] = 0x81;
    struct zmk_pmw3610_relay_notification event = {.source = 1};
    pb_ostream_t stream = pb_ostream_from_buffer(event.payload, sizeof(event.payload));
    zassert_true(pb_encode(&stream, cormoran_pmw3610_Notification_fields, &notification));
    event.size = stream.bytes_written;
    return event;
}
static struct zmk_pmw3610_relay_response response(uint32_t id) {
    cormoran_pmw3610_RelayResponse response = cormoran_pmw3610_RelayResponse_init_zero;
    response.request_id = id;
    response.has_response = true;
    response.response.which_response_type = cormoran_pmw3610_Response_set_frame_stream_tag;
    response.response.response_type.set_frame_stream.streaming = true;
    struct zmk_pmw3610_relay_response event = {.source = 1};
    pb_ostream_t stream = pb_ostream_from_buffer(event.payload, sizeof(event.payload));
    zassert_true(pb_encode(&stream, cormoran_pmw3610_RelayResponse_fields, &response));
    event.size = stream.bytes_written;
    return event;
}

ZTEST(relay, test_busy_queue_preserves_all_four_chunks_in_order) {
    zassert_not_equal(request(true), 0);
    test_block_queue();
    for (unsigned i = 0; i < 4; i++) {
        struct zmk_pmw3610_relay_notification event = chunk(i * 128);
        on_pmw3610_relay_notification(&event);
    }
    test_release_queue();
    test_drain_queue();
    zassert_equal(test_notification_count, 4);
    for (unsigned i = 0; i < 4; i++) {
        zassert_equal(test_notifications[i].notification_type.frame_stream_chunk.offset, i * 128);
        zassert_equal(test_notifications[i].notification_type.frame_stream_chunk.source, 1);
    }
}

ZTEST(relay, test_busy_queue_preserves_each_response) {
    test_block_queue();
    for (unsigned i = 0; i < 4; i++) {
        struct zmk_pmw3610_relay_response event = response(request(false));
        on_pmw3610_relay_response(&event);
    }
    test_release_queue();
    test_drain_queue();
    zassert_equal(test_notification_count, 4);
    for (unsigned i = 0; i < 4; i++) {
        zassert_equal(test_notifications[i].notification_type.peripheral_response.request_id,
                      i + 1);
    }
}

ZTEST(relay, test_lock_drops_queued_and_late_chunks_until_new_start) {
    request(true);
    test_block_queue();
    struct zmk_pmw3610_relay_notification event = chunk(0);
    on_pmw3610_relay_notification(&event);
    test_lock();
    on_pmw3610_relay_notification(&event);
    test_lock_state = ZMK_STUDIO_CORE_LOCK_STATE_UNLOCKED;
    on_pmw3610_relay_notification(&event);
    test_release_queue();
    test_drain_queue();
    zassert_equal(test_notification_count, 0);
    zassert_equal(test_stop_count, 1);
    request(true);
    on_pmw3610_relay_notification(&event);
    test_drain_queue();
    zassert_equal(test_notification_count, 1);
}

ZTEST(relay, test_late_response_cannot_cross_lock_unlock_boundary) {
    uint32_t retired = request(false);
    test_lock();
    test_lock_state = ZMK_STUDIO_CORE_LOCK_STATE_UNLOCKED;
    struct zmk_pmw3610_relay_response event = response(retired);
    on_pmw3610_relay_response(&event);
    test_drain_queue();
    zassert_equal(test_notification_count, 0);
    event = response(request(false));
    on_pmw3610_relay_response(&event);
    test_drain_queue();
    zassert_equal(test_notification_count, 1);
}

ZTEST(relay, test_queue_overflow_keeps_owned_packets_and_rejects_oversized_input) {
    request(true);
    test_block_queue();
    for (unsigned i = 0; i < CONFIG_ZMK_PMW3610_RELAY_QUEUE_DEPTH + 3; i++) {
        struct zmk_pmw3610_relay_notification event = chunk(i * 32);
        on_pmw3610_relay_notification(&event);
    }
    struct zmk_pmw3610_relay_notification oversized = {.size = sizeof(oversized.payload) + 1};
    zassert_equal(on_pmw3610_relay_notification(&oversized), -EMSGSIZE);
    test_release_queue();
    test_drain_queue();
    zassert_equal(test_notification_count, CONFIG_ZMK_PMW3610_RELAY_QUEUE_DEPTH);
    for (unsigned i = 0; i < test_notification_count; i++) {
        zassert_equal(test_notifications[i].notification_type.frame_stream_chunk.offset, i * 32);
    }
}

ZTEST(relay, test_failed_stop_is_retried_and_new_start_retires_retry) {
    test_stop_error = -ENOMEM;
    test_lock();
    zassert_true(stop_pending);
    zassert_equal(test_stop_count, 1);
    test_stop_error = 0;
    k_sleep(K_MSEC(25));
    test_drain_queue();
    zassert_false(stop_pending);
    zassert_equal(test_stop_count, 2);
    test_stop_error = -ENOMEM;
    pmw3610_relay_revoke_session();
    test_lock_state = ZMK_STUDIO_CORE_LOCK_STATE_UNLOCKED;
    request(true);
    unsigned count = test_stop_count;
    k_sleep(K_MSEC(25));
    test_drain_queue();
    zassert_equal(test_stop_count, count);
}

ZTEST(relay, test_renewal_preserves_queued_frames_and_cannot_reopen_retired_forwarding) {
    request(true);
    uint32_t generation = (uint32_t)atomic_get(&relay_stream_generation);
    test_block_queue();
    struct zmk_pmw3610_relay_notification event = chunk(0);
    on_pmw3610_relay_notification(&event);
    cormoran_pmw3610_Request renewal = cormoran_pmw3610_Request_init_zero;
    renewal.which_request_type = cormoran_pmw3610_Request_set_frame_stream_tag;
    renewal.request_type.set_frame_stream.enable = true;
    renewal.request_type.set_frame_stream.renew_only = true;
    renewal.request_type.set_frame_stream.stream_epoch = 19;
    zassert_not_equal(send_relay_request(&renewal), 0);
    zassert_equal((uint32_t)atomic_get(&relay_stream_generation), generation);
    zassert_equal(k_msgq_num_used_get(&relay_notification_queue), 1);
    test_release_queue();
    test_drain_queue();
    zassert_equal(test_notification_count, 1);
    pmw3610_relay_revoke_session();
    zassert_false(atomic_get(&relay_stream_enabled));
    zassert_not_equal(send_relay_request(&renewal), 0);
    zassert_false(atomic_get(&relay_stream_enabled));
}

#else
static struct zmk_pmw3610_relay_request request(uint32_t id, bool stream) {
    cormoran_pmw3610_RelayRequest request = cormoran_pmw3610_RelayRequest_init_zero;
    request.request_id = id;
    request.has_request = true;
    request.request.which_request_type = stream ? cormoran_pmw3610_Request_set_frame_stream_tag
                                                : cormoran_pmw3610_Request_get_info_tag;
    if (stream)
        request.request.request_type.set_frame_stream.enable = true;
    struct zmk_pmw3610_relay_request event = {.source = 1};
    pb_ostream_t stream_out = pb_ostream_from_buffer(event.payload, sizeof(event.payload));
    zassert_true(pb_encode(&stream_out, cormoran_pmw3610_RelayRequest_fields, &request));
    event.size = stream_out.bytes_written;
    return event;
}
static void stop(void) {
    struct zmk_pmw3610_relay_stop event = {.source = 1};
    on_pmw3610_relay_stop(&event);
}
ZTEST(relay, test_busy_queue_preserves_each_request) {
    test_block_queue();
    for (unsigned i = 0; i < 4; i++) {
        struct zmk_pmw3610_relay_request event = request(i + 1, false);
        on_pmw3610_relay_request(&event);
    }
    test_release_queue();
    test_drain_queue();
    zassert_equal(test_response_count, 4);
    for (unsigned i = 0; i < 4; i++)
        zassert_equal(test_responses[i].request_id, i + 1);
}
ZTEST(relay, test_stop_bypasses_full_queue_and_retires_pending_starts) {
    test_block_queue();
    for (unsigned i = 0; i < CONFIG_ZMK_PMW3610_RELAY_QUEUE_DEPTH; i++) {
        struct zmk_pmw3610_relay_request event = request(i + 1, true);
        on_pmw3610_relay_request(&event);
    }
    stop();
    test_release_queue();
    test_drain_queue();
    zassert_equal(test_begin_calls[0], 0);
    zassert_equal(test_response_count, 0);
}
ZTEST(relay, test_stop_during_admitted_begin_leaves_no_session) {
    test_begin_hook = stop;
    struct zmk_pmw3610_relay_request event = request(1, true);
    on_pmw3610_relay_request(&event);
    test_drain_queue();
    zassert_equal(test_begin_calls[0], 1);
    zassert_equal(test_end_calls[0], 1);
    zassert_false(test_sensor_capturing[0]);
    zassert_equal(test_notification_count, 0);
    zassert_equal(test_response_count, 0);
}

ZTEST(relay, test_disconnect_retires_queued_stream_start) {
    test_block_queue();
    struct zmk_pmw3610_relay_request event = request(1, true);
    on_pmw3610_relay_request(&event);
    test_disconnect();
    test_release_queue();
    test_drain_queue();
    zassert_equal(test_begin_calls[0], 0);
    zassert_equal(test_response_count, 0);
}
#endif

ZTEST_SUITE(relay, NULL, NULL, before, NULL, NULL);
```
